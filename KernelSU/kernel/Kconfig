## KernelSU/kernel/Kconfig
```kconfig
menu "KernelSU"

config KSU
	tristate "KernelSU function support"
	depends on OVERLAY_FS
	default y
	help
	  Enable kernel-level root privileges on Android System.
	  To compile as a module, choose M here: the
	  module will be called kernelsu.

config KSU_DEBUG
	bool "KernelSU debug mode"
	depends on KSU
	default n
	help
	  Enable KernelSU debug mode.

config KSU_VERSION
	int "KernelSU version"
	depends on KSU
	default 16
	help
	  KSU version (10000 + git commits on KernelSU repo + 200)

endmenu
```
